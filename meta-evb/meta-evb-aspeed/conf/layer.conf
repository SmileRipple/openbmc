## meta-evb/meta-evb-aspeed/conf/layer.conf
```bitbake
# We have a conf and classes directory, add to BBPATH
BBPATH .= ":${LAYERDIR}"

BBFILE_COLLECTIONS += "evb-aspeed"
BBFILE_PATTERN_evb-aspeed = ""
#BBFILE_PATTERN_evb-aspeed := "^${LAYERDIR}/"
#LAYERVERSION_aspeed-layer= "1"
LAYERSERIES_COMPAT_evb-aspeed = "warrior zeus"
```

## meta-evb/meta-evb-aspeed/meta-evb-ast2600/conf/layer.conf
```bitbake
# We have a conf and classes directory, add to BBPATH
BBPATH .= ":${LAYERDIR}"

# We have recipes-* directories, add to BBFILES
#BBFILES += "${LAYERDIR}/recipes-*/*/*.bb \
#            ${LAYERDIR}/recipes-*/*/*.bbappend"

BBFILE_COLLECTIONS += "evb-ast2600"
BBFILE_PATTERN_evb-ast2600 = ""
#LAYERSERIES_COMPAT_evb-ast2600 = "warrior zeus"
```
